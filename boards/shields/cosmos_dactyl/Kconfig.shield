## boards/shields/cosmos_dactyl/Kconfig.shield
```kconfig
# Copyright (c) 2020 Ryan Cross
# SPDX-License-Identifier: MIT

config SHIELD_COSMOS_DACTYL_LEFT
    def_bool $(shields_list_contains,cosmos_dactyl_left)

config SHIELD_COSMOS_DACTYL_RIGHT
    def_bool $(shields_list_contains,cosmos_dactyl_right)
```

## config/west.yml
```yaml
manifest:
  remotes:
    - name: zmkfirmware
      url-base: https://github.com/zmkfirmware

    # support for pmw3610 driver for the trackballs
    - name: badjeff
      url-base: https://github.com/badjeff

    # support nice_oled and nice_epaper
    - name: mctechnology17
      url-base: https://github.com/mctechnology17

    # ZMK Dongle Display
    - name: englmaxi
      url-base: https://github.com/englmaxi
  projects:
    - name: zmk
      remote: zmkfirmware
      revision: v0.2
      import: app/west.yml

    # support for pmw3610 driver for the trackballs
    - name: zmk-pmw3610-driver
      remote: badjeff
      revision: main

    # support nice_oled and nice_epaper
    - name: zmk-nice-oled
      remote: mctechnology17
      revision: main

    # ZMK Dongle Display
    - name: zmk-dongle-display
      remote: englmaxi
      revision: main
  self:
    path: config
```
